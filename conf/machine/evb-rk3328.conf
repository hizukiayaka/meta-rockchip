## conf/machine/evb-rk3328.conf
```bitbake
# Released under the MIT license (see COPYING.MIT for the terms)

#@TYPE: Machine
#@NAME: EVB 3388

include conf/machine/include/rk3328.inc

KERNEL_DEVICETREE = "rockchip/rk3328-evb.dtb"
UBOOT_MACHINE = "evb-rk3328_defconfig"

GPTIMG_APPEND = "console=ttyS2,1500000n8 rw root=PARTUUID=B921B045-1DF0 rootfstype=ext4 init=/sbin/init"
```

## conf/machine/excavator-rk3399.conf
```bitbake
# Copyright (C) 2017 Fuzhou Rockchip Electronics Co., Ltd
# Released under the MIT license (see COPYING.MIT for the terms)

#@TYPE: Machine
#@NAME: EXCAVATOR 3399

include conf/machine/include/rk3399.inc

KERNEL_DEVICETREE = "rockchip/rk3399-sapphire-excavator-linux.dtb"
UBOOT_MACHINE = "evb-rk3399_defconfig"

PREFERRED_PROVIDER_virtual/kernel = "linux-rockchip"

GPTIMG_APPEND = "console=ttyS2,1500000n8 rw root=PARTUUID=B921B045-1DF0 rootfstype=ext4 init=/sbin/init"
```

## conf/machine/firefly-rk3288.conf
```bitbake
# Copyright (C) 2015 Romain Perier
# Released under the MIT license (see COPYING.MIT for the terms)

#@TYPE: Machine
#@NAME: Firefly RK3288
#@DESCRIPTION: Firefly-RK3288 is a high-performance platform, with strong computing power, graphic processing and video decoding ability.
#http://www.t-firefly.com/en/

require conf/machine/include/rk3288.inc

PREFERRED_PROVIDER_virtual/kernel = "linux-rockchip"

KERNEL_DEVICETREE = "rk3288-firefly.dtb"
UBOOT_MACHINE = "firefly-rk3288_defconfig"
GPTIMG_APPEND = "console=tty1 console=ttyS2,115200n8 rw root=/dev/mmcblk0p7 rootfstype=ext4 init=/sbin/init"
```

## conf/machine/firefly-rk3399.conf
```bitbake
# Copyright (C) 2017 Fuzhou Rockchip Electronics Co., Ltd
# Released under the MIT license (see COPYING.MIT for the terms)

#@TYPE: Machine
#@NAME: Firefly RK3399
#@DESCRIPTION: Firefly-RK3399 is a Six-Core 64-bit High-Performance Platform.
#http://www.t-firefly.com/en/

include conf/machine/include/rk3399.inc

KERNEL_DEVICETREE = "rockchip/rk3399-firefly.dtb"
UBOOT_MACHINE = "evb-rk3399_defconfig"

GPTIMG_APPEND = "console=ttyS2,1500000n8 rw root=PARTUUID=B921B045-1DF0 rootfstype=ext4 init=/sbin/init"
```

## conf/machine/include/rk1808.inc
```bitbake
# Copyright (C) SUMOMO Computer Assocation
# Released under the MIT license (see COPYING.MIT for the terms)

SOC_FAMILY = "rk1808"

require conf/machine/include/tune-cortexa35.inc
require conf/machine/include/soc-family.inc
require conf/machine/include/rockchip-defaults.inc

SERIAL_CONSOLES = "1500000;ttyS2"
KERNEL_IMAGETYPE = "Image"
KBUILD_DEFCONFIG = "defconfig"

PREFERRED_PROVIDER_virtual/bootloader ?= "u-boot-rockchip"

IMAGE_FSTYPES = "rockchip-gpt-img"
IMAGE_CLASSES = "rockchip-gpt-img"
```

## conf/machine/include/rk3036.inc
```bitbake
# Copyright (C) 2018 Randy 'ayaka' Li <ayaka@soulik.info>
# Released under the MIT license (see COPYING.MIT for the terms)

SOC_FAMILY = "rk3036"

require conf/machine/include/tune-cortexa7.inc
require conf/machine/include/soc-family.inc
require conf/machine/include/rockchip-defaults.inc

SERIAL_CONSOLES = "115200;ttyS2"

PREFERRED_PROVIDER_virtual/bootloader ?= "u-boot-rockchip"
SPL_BINARY ?= "u-boot-spl-nodtb.bin"

IMAGE_FSTYPES = "rockchip-gpt-img"
IMAGE_CLASSES = "rockchip-gpt-img"
```

## conf/machine/include/rk312x.inc
```bitbake
# Copyright (C) 2019 SUMOMO Computer Assocation
# Released under the MIT license (see COPYING.MIT for the terms)

# a serial of chips
SOC_FAMILY = "rk312x"

require conf/machine/include/tune-cortexa7.inc
require conf/machine/include/soc-family.inc
require conf/machine/include/rockchip-defaults.inc

SERIAL_CONSOLES = "115200;ttyS2"

PREFERRED_PROVIDER_virtual/bootloader ?= "u-boot-rockchip"
SPL_BINARY ?= "u-boot-spl-nodtb.bin"

IMAGE_FSTYPES = "rockchip-gpt-img"
IMAGE_CLASSES = "rockchip-gpt-img"
```

## conf/machine/include/rk3188.inc
```bitbake
# Copyright (C) 2015 Romain Perier
# Released under the MIT license (see COPYING.MIT for the terms)

require conf/machine/include/rk3066.inc
```

## conf/machine/include/rk3288.inc
```bitbake
# Copyright (C) 2015 Romain Perier
# Released under the MIT license (see COPYING.MIT for the terms)

SOC_FAMILY = "rk3288"

require conf/machine/include/tune-cortexa17.inc
require conf/machine/include/soc-family.inc
require conf/machine/include/rockchip-defaults.inc

SERIAL_CONSOLES = "115200;ttyS2"

PREFERRED_PROVIDER_virtual/bootloader ?= "u-boot"
SPL_BINARY ?= "u-boot-spl-dtb.bin"

IMAGE_FSTYPES = "rockchip-gpt-img"
IMAGE_CLASSES += "rockchip-gpt-img"
```

## conf/machine/include/rk3326.inc
```bitbake
# Copyright (C) 2019 SUMOMO Computer Association
# Released under the MIT license (see COPYING.MIT for the terms)

# PX30 is the same SoC as rk3326.
SOC_FAMILY = "rk3326"

require conf/machine/include/tune-cortexa35.inc
require conf/machine/include/soc-family.inc
require conf/machine/include/rockchip-defaults.inc

SERIAL_CONSOLES = "1500000;ttyS2"
KERNEL_IMAGETYPE = "Image"
KBUILD_DEFCONFIG = "defconfig"

PREFERRED_PROVIDER_virtual/bootloader ?= "u-boot-rockchip"

IMAGE_FSTYPES = "rockchip-gpt-img"
IMAGE_CLASSES = "rockchip-gpt-img"
```

## conf/machine/include/rk3328.inc
```bitbake
# Copyright (C) 2017 Randy Li <ayaka@soulik.info>
# Released under the MIT license (see COPYING.MIT for the terms)

# RK3228H is the same SoC as rk3328.
SOC_FAMILY = "rk3328"

require conf/machine/include/tune-cortexa53.inc
require conf/machine/include/soc-family.inc
require conf/machine/include/rockchip-defaults.inc

SERIAL_CONSOLES = "1500000;ttyS2"
KERNEL_IMAGETYPE = "Image"
KBUILD_DEFCONFIG = "defconfig"

PREFERRED_PROVIDER_virtual/bootloader ?= "u-boot-rockchip"

IMAGE_FSTYPES = "rockchip-gpt-img"
IMAGE_CLASSES = "rockchip-gpt-img"
```

## conf/machine/include/rk3399.inc
```bitbake
# Copyright (C) 2019 SUMOMO Computer Association
# Released under the MIT license (see COPYING.MIT for the terms)

SOC_FAMILY = "rk3399"

require conf/machine/include/tune-cortexa72.inc
require conf/machine/include/soc-family.inc
require conf/machine/include/rockchip-defaults.inc

SERIAL_CONSOLES = "1500000;ttyS2"
KERNEL_IMAGETYPE = "Image"
KBUILD_DEFCONFIG = "defconfig"

PREFERRED_PROVIDER_virtual/bootloader ?= "u-boot-rockchip"

IMAGE_FSTYPES = "rockchip-gpt-img"
IMAGE_CLASSES = "rockchip-gpt-img"
```

## conf/machine/include/rockchip-defaults.inc
```bitbake
# meta-rockchip default settings

# kernel
PREFERRED_PROVIDER_virtual/kernel ?= "linux-stable"
LINUX_VERSION_EXTENSION ?= "-rockchip"
KBUILD_DEFCONFIG = "multi_v7_defconfig"
KERNEL_IMAGETYPE = "zImage"

# xserver
PREFERRED_PROVIDER_virtual/xserver = "xserver-xorg"
XSERVER = " \
	xserver-xorg \
	xserver-xorg-utils \
	xserver-xorg-xvfb \
	xserver-xorg-extension-glx \
	xserver-xorg-module-libwfb \
	xserver-xorg-module-exa \
	xf86-video-modesetting \
	xf86-input-evdev \
	xf86-input-mouse \
	xf86-input-keyboard \
	"

# misc
IMAGE_FSTYPES += "ext4"
```

## conf/machine/include/rv1108.inc
```bitbake
# Copyright (C) 2019 Randy 'ayaka' Li <ayaka@soulik.info>
# Released under the MIT license (see COPYING.MIT for the terms)

SOC_FAMILY = "rv1108"

require conf/machine/include/tune-cortexa7.inc
require conf/machine/include/soc-family.inc
require conf/machine/include/rockchip-defaults.inc

SERIAL_CONSOLES = "1500000;ttyS2"

PREFERRED_PROVIDER_virtual/bootloader ?= "u-boot-rockchip"
SPL_BINARY ?= "u-boot-spl-nodtb.bin"

IMAGE_FSTYPES = "rockchip-gpt-img"
IMAGE_CLASSES = "rockchip-gpt-img"
```

## conf/machine/kylin-rk3036.conf
```bitbake
# Copyright (C) 2017 Fuzhou Rockchip Electronics Co., Ltd
# Released under the MIT license (see COPYING.MIT for the terms)

#@TYPE: Machine
#@NAME: Kylin rk3036

include conf/machine/include/rk3036.inc

KERNEL_DEVICETREE = "rk3036-kylin.dtb"
UBOOT_MACHINE = "kylin-rk3036_defconfig"

GPTIMG_APPEND = "console=ttyS2,115200n8 rw root=PARTUUID=69DAD710-2CE4 rootfstype=ext4 init=/sbin/init"
```

## conf/machine/rk3188.conf
```bitbake
# Copyright (C) 2014 NEO-Technologies
# Released under the MIT license (see COPYING.MIT for the terms)

#@TYPE: Machine
#@NAME: Generic RK3188
#@DESCRIPTION: Machine configuration based on Rockchip RK3188 CPU

require conf/machine/include/rk3188.inc

PREFERRED_PROVIDER_virtual/kernel = "linux-rockchip-3.0-rk3188"
```

## conf/machine/rk3288-firefly.conf
```bitbake
# Copyright (C) 2015 Romain Perier
# Released under the MIT license (see COPYING.MIT for the terms)

#@TYPE: Machine
#@NAME: Firefly RK3288
#@DESCRIPTION: Machine configuration for the firefly RK3288, based on Rockchip RK33288 SoC
#http://www.t-firefly.com/en/

include conf/machine/include/rk3288.inc
KERNEL_DEVICETREE = "rk3288-firefly.dtb"
```

## conf/machine/rk3288-veyron-speedy.conf
```bitbake
# Copyright (C) 2015 Romain Perier
# Released under the MIT license (see COPYING.MIT for the terms)

#@TYPE: Machine
#@NAME: RK3288 Speedy
#@DESCRIPTION: Google Veyron Speedy Rev 1+ board (formally known as Chromebook Asus C201)
#https://www.google.com/chromebook/find/#?device=asus-chromebook-c201

include conf/machine/include/rk3288.inc
KERNEL_DEVICETREE = "rk3288-veyron-speedy.dtb"
```

## conf/machine/rock-pro-64.conf
```bitbake
# Copyright (C) 2026 Randy Li
# Released under the MIT license (see COPYING.MIT for the terms)

#@TYPE: Machine
#@NAME: RockPro64
#@DESCRIPTION: RockPro64 RK3399 board from Pine64

require include/rk3399.inc

MACHINE_FEATURES += "usbhost serial"

UBOOT_MACHINE = "rockpro64-rk3399_defconfig"
KERNEL_DEVICETREE = "rockchip/rk3399-rockpro64.dtb"

KBUILD_DEFCONFIG = "defconfig"
```

## conf/machine/tinker-rk3288.conf
```bitbake
# Copyright (C) 2018  Trevor Woerner
# Released under the MIT license (see COPYING.MIT for the terms)

#@TYPE: Machine
#@NAME: Tinker RK3288
#@DESCRIPTION: ASUS Tinker Board is a Raspberry Pi 3 Alternative based on Rockchip RK3288 Processor.

require conf/machine/include/rk3288.inc

KERNEL_DEVICETREE = "rk3288-tinker.dtb"
UBOOT_MACHINE = "tinker-rk3288_defconfig"
GPTIMG_APPEND = "console=tty1 console=ttyS2,115200n8 rw root=/dev/mmcblk0p7 rootfstype=ext4 init=/sbin/init"
```
